## firmware/sdkconfig.defaults
```kconfig
# AirCube Default Configuration for ESP32-H2

# Target chip
CONFIG_IDF_TARGET="esp32h2"

# Bluetooth Configuration
CONFIG_BT_ENABLED=y
CONFIG_BT_BLUEDROID_ENABLED=y
CONFIG_BT_BLE_ENABLED=y
CONFIG_BT_CLASSIC_ENABLED=n
CONFIG_BT_CONTROLLER_ONLY=n

# BLE Configuration
CONFIG_BT_BLE_42_FEATURES_SUPPORTED=y
CONFIG_BT_GATTS_ENABLE=y
CONFIG_BT_GATTC_ENABLE=n
CONFIG_BT_GAP_ENABLE=y

# Bluetooth Controller Configuration
CONFIG_BT_CTRL_BLE_MAX_ACT=10
CONFIG_BT_CTRL_BLE_STATIC_ACL_TX_BUF_NB=0
CONFIG_BT_CTRL_BLE_ADV_REPORT_FLOW_CTRL_SUPP=y
CONFIG_BT_CTRL_BLE_ADV_REPORT_FLOW_CTRL_NUM=100
CONFIG_BT_CTRL_BLE_ADV_REPORT_DISCARD_THRSHOLD=20

# FreeRTOS Configuration
CONFIG_FREERTOS_IDLE_TASK_STACKSIZE=1536
CONFIG_FREERTOS_TIMER_TASK_STACK_DEPTH=2048

# Enable debugging
CONFIG_LOG_DEFAULT_LEVEL_INFO=y
CONFIG_LOG_MAXIMUM_LEVEL=4

# NVS Configuration
CONFIG_NVS_ENCRYPTION=n

# Partition table
CONFIG_PARTITION_TABLE_SINGLE_APP=y

# Memory configuration
CONFIG_ESP_MAIN_TASK_STACK_SIZE=4096

# Console configuration
CONFIG_ESP_CONSOLE_UART_DEFAULT=y
```
